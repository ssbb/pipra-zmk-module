## boards/arm/pipra/Kconfig.board
```kconfig
# Copyright (c) 2025 The ZMK Contributors
# SPDX-License-Identifier: MIT

config BOARD_PIPRA_LEFT
    bool "pipra left"
    select ZMK_KSCAN_EC_MATRIX_FAKE_OPEN_DRAIN
    imply ZMK_KSCAN_EC_MATRIX_DYNAMIC_POLL_RATE
    depends on SOC_NRF52840_QIAA

config BOARD_PIPRA_RIGHT
    bool "pipra right"
    select ZMK_KSCAN_EC_MATRIX_FAKE_OPEN_DRAIN
    imply ZMK_KSCAN_EC_MATRIX_DYNAMIC_POLL_RATE
    depends on SOC_NRF52840_QIAA
```

## boards/arm/pipra/Kconfig.defconfig
```kconfig
# Copyright (c) 2025 The ZMK Contributors
# SPDX-License-Identifier: MIT

if BOARD_PIPRA_LEFT

config ZMK_KEYBOARD_NAME
    default "Pipra"

config ZMK_SPLIT_ROLE_CENTRAL
    default y

endif # BOARD_PIPRA_LEFT


if BOARD_PIPRA_LEFT || BOARD_PIPRA_RIGHT

config BOARD
    default "pipra"

config ZMK_SPLIT
    default y

config BT_CTLR
    default BT

config ZMK_MAX17048
    default y

if USB

config USB_NRFX
    default y

config USB_DEVICE_STACK
    default y

config I2C
  default y

config ZMK_MAX17048
	default y

endif # USB

endif # BOARD_PIPRA_LEFT || BOARD_PIPRA_RIGHT
```

## boards/arm/pipra/pipra_right_defconfig
```kconfig
# Copyright (c) 2025 The ZMK Contributors
# SPDX-License-Identifier: MIT

CONFIG_BOARD_PIPRA_RIGHT=y

CONFIG_SOC_SERIES_NRF52X=y
CONFIG_SOC_NRF52840_QIAA=y

# Enable MPU
CONFIG_ARM_MPU=y

# Enable GPIO
CONFIG_PINCTRL=y
CONFIG_GPIO=y
CONFIG_ADC=y

CONFIG_I2C=y
CONFIG_I2C_NRFX=y

CONFIG_ZMK_USB=y
CONFIG_ZMK_BLE=y

# Enable flash
CONFIG_USE_DT_CODE_PARTITION=y
CONFIG_BUILD_OUTPUT_UF2=y
CONFIG_MPU_ALLOW_FLASH_WRITE=y
CONFIG_NVS=y
CONFIG_SETTINGS_NVS=y
CONFIG_FLASH=y
CONFIG_FLASH_PAGE_LAYOUT=y
CONFIG_FLASH_MAP=y

CONFIG_ZMK_KSCAN_EC_MATRIX_VERBOSE_CALIBRATOR=y
```

## boards/ssbb/pipra/Kconfig.pipra_right
```kconfig
config BOARD_PIPRA_RIGHT
    select ZMK_KSCAN_EC_MATRIX_FAKE_OPEN_DRAIN
    imply ZMK_KSCAN_EC_MATRIX_DYNAMIC_POLL_RATE
    select SOC_NRF52840_QIAA
```

## boards/ssbb/pipra/board.yml
```yaml
boards:
  - name: pipra_left
    vendor: ssbb
    socs:
      - name: nrf52840
        variants:
          - name: zmk
    revision:
      format: major.minor.patch
      default: 1.0.0
      exact: true
      revisions:
        - name: 0.1.0
        - name: 1.0.0
  - name: pipra_right
    vendor: ssbb
    socs:
      - name: nrf52840
        variants:
          - name: zmk
    revision:
      format: major.minor.patch
      default: 1.0.0
      exact: true
      revisions:
        - name: 0.1.0
        - name: 1.0.0
```

## config/west.yml
```yaml
manifest:
  remotes:
    - name: zmkfirmware
      url-base: https://github.com/zmkfirmware
    - name: petejohanson
      url-base: https://github.com/petejohanson
    - name: caksoylar
      url-base: https://github.com/caksoylar
  projects:
    - name: zmk
      remote: zmkfirmware
      revision: main
      import: app/west.yml
    - name: ec-support-zmk-module
      remote: petejohanson
      revision: main
    - name: zmk-rgbled-widget
      remote: caksoylar
      revision: main
  self:
    path: config
```
